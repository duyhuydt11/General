/dts-v1/;
/plugin/;

/ {
    fragment@0 {
        target = <&i2c1>;   
        __overlay__ {
            #address-cells = <1>;
            #size-cells = <0>;
            

            ina219@40 {
                compatible = "ti,ina219";
                reg = <0x40>;
                status = "okay";
            };
        };
    };
};
